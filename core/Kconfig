## core/Kconfig
```kconfig
mainmenu "CORE Configuration Menu"

menu "Build Options"
config CC_DEBUG
	bool "Enable debug information"
	default n

config CC_ASAN
	bool "Enable address sanitizer"
	default n

endmenu

config WATCHPOINT
	bool "Enable watchpoint"
	default y
	help
		set this to enable watchpoint scan for each execution

menu "Tracer"

config TRACE
	bool "Enable tracer"
	default y

config TRACE_START
	depends on TRACE
	int "When tracing is enabled (unit: number of instructions)"
	default 0

config TRACE_END
	depends on TRACE
	int "When tracing is disabled (unit: number of instructions)"
	default 10000

config TRACE_WAVE
	depends on TRACE
	bool "Enable waveform tracer"
	default y

config MAX_WAVE
	depends on TRACE_WAVE
	int "How many time points are traced"
	default 100000

config WAVE_BEGIN
	depends on TRACE_WAVE
	int "The number of instruction begin to trace"
	default 0

config ITRACE
	depends on TRACE
	bool "Enable instruction tracer"
	default y

config IRINGTRACE
	depends on ITRACE
	bool "Enable iring buf tracer"
	default y

config MTRACE
	depends on TRACE
	bool "Enable memory tracer"
	default n

config MTRACE_START
	depends on MTRACE
	hex "memory trace left range (unit: addr of memory)"
	default 0x0

config MTRACE_END
	depends on MTRACE
	hex "memory trace right range (unit: addr of memory)"
	default 0x80000000

config FTRACE
	depends on TRACE
	bool "Enable function tracer"
	default n

endmenu

config DIFFTEST
	bool "Enable differential testing"
	default n
	help
		Enable differential testing with a reference design.
		 Note that this will significantly reduce the performance of CORE.
```
